## firmware/components/clock_board/Kconfig
```kconfig
menu "matrix_clock - target board"

choice CLOCK_BOARD
    prompt "Pin profile"
    default CLOCK_BOARD_HORLOGE_V1
    help
      Selects the compiled pin profile. See documentation/cartes/.

config CLOCK_BOARD_HORLOGE_V1
    bool "horloge-v1 (ESP32-WROOM-32 devkit, 4 MB, no PSRAM)"
    help
      WS2812B 8x32 data on GPIO13 (SPI2 MOSI), photoresistor on GPIO33
      (ADC1_CH5), ENS160+AHT21 on I2C GPIO27 (SDA) / GPIO26 (SCL).
      See documentation/cartes/horloge-v1/README.md.

config CLOCK_BOARD_DEVKIT
    bool "bare devkit on the bench (same pins, nothing has to be connected)"
    help
      Same pin plan as horloge-v1, for a board with no panel attached: driving
      an unconnected data pin is harmless. Exists so a second devkit can run the
      firmware for network / web / Home Assistant work without the matrix.

endchoice

endmenu
```

## firmware/components/clock_display/Kconfig
```kconfig
menu "matrix_clock - LED panel driver"

choice CLOCK_LED_BACKEND
    prompt "led_strip backend"
    default CLOCK_LED_BACKEND_SPI
    help
      SPI uses DMA and costs the CPU nothing per frame. RMT on the classic ESP32
      has no DMA: 256 LEDs x 24 bits x 1.25 us = 7.7 ms of interrupt-fed
      transmission per frame, competing with Wi-Fi. Kept selectable in case the
      SPI backend misbehaves on a given panel.

config CLOCK_LED_BACKEND_SPI
    bool "SPI2 with DMA (default)"

config CLOCK_LED_BACKEND_RMT
    bool "RMT (no DMA on ESP32)"

endchoice

endmenu
```

## firmware/components/clock_web/Kconfig
```kconfig
menu "matrix_clock - network"

    config CLOCK_WIFI_AP_PASSWORD
        string "Access point password (empty = derived from the MAC)"
        default ""
        help
          Access point + captive portal "Horloge-xxxx" (http://192.168.4.1),
          raised when no network is configured or in fallback. Empty: WPA2 with
          a password derived from the MAC address, shown on the panel and in
          the console. Otherwise at least 8 characters. Lives in sdkconfig,
          which is git-ignored: never commit it.

    config CLOCK_MDNS_HOSTNAME
        string "mDNS host name (without .local)"
        default "horloge"

endmenu
```
